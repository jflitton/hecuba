// capture.c - clocked whole-track capture: PIO samples READ DATA on READ/REF
// CLOCK, DMA streams it to SRAM. Runs on core1 (CORE-4) so the host link and
// register bus on core0 are never starved. Core1 also services the optional
// per-field -READ GATE re-sync while a capture is armed (see gate_service).

#include "capture.h"
#include "board_pins.h"

#include "pico/stdlib.h"
#include "pico/multicore.h"
#include "hardware/pio.h"
#include "hardware/dma.h"
#include "hardware/gpio.h"
#include "hardware/timer.h"

#include "capture.pio.h"   // generated by pico_generate_pio_header()

// The PIO `wait gpio` clock pin must match the board map.
_Static_assert(capture_CAPTURE_CLK_GPIO == PIN_READ_REF_CLK,
               "capture.pio CAPTURE_CLK_GPIO must equal PIN_READ_REF_CLK");

// Whole-track buffer in core-shared SRAM (CORE-3). ~15 KB; 520 KB SRAM leaves
// room for 30+ tracks if we later double-buffer / batch.
static uint32_t s_track_buf[CAPTURE_WORDS];

static PIO  s_pio;
static uint s_sm;
static uint s_offset;
static int  s_dma_chan;

// Max time to wait for the once-per-rev INDEX edge (rev is ~16.67 ms).
#define INDEX_TIMEOUT_US  60000u

// Max wait for the track DMA. A full track at 6.4 Mbit/s is ~19 ms; if the
// READ/REF CLOCK stalls or never appears (VFO unlocked, cabling), the PIO
// stops pushing and the DMA would otherwise hang core1 (and with it the
// console) forever, with the drive still spinning.
#define DMA_TIMEOUT_MS    250u

// ---- Per-field -READ GATE re-sync ---------------------------------------------
// -READ GATE is pulsed off and back on per field while a capture is armed, as
// the original controller did:
//   * PRIAM OEM/Service Manual 308000-0, Fig 3-40 / Table 3-15: READ GATE is
//     asserted in the zero gap after SECTOR MARK and dropped before the next
//     write splice; READ DATA is invalid for 9 us (PLO sync) after assertion.
//   * iSBC 215 Hardware Reference Manual 121593-002, para 4-29/4-30: RD GATE
//     is reset by END TIME at the end of the ID field's ECC and "again raised
//     to search for the sync byte of the data field".
// With the gate held across a write splice the separator's output for the
// following field is unreliable and the field fails ECC.
//
// Timing for the iSBC 215 sector format (1.24 us/byte), from the SECTOR MARK
// leading edge:
//   ID sync byte        ~22 us
//   ID field end        ~33 us   (9 bytes)
//   data write splice   ~44 us   (the 215 writes ID fields and data fields
//                                 in separate format passes; every sector
//                                 has it)
//   data sync byte      ~68 us   (28 bytes after the ID field)
// GATING_MARK: gate off for drop_us at the mark. GATING_BOTH (default): also
// off from data_off_us to data_off_us + data_drop_us after the mark; 37..48 us
// spans the splice and leaves ~18 us of zeros before the data sync byte.
//
// Polled on core1 during the INDEX wait and the DMA wait. SECTOR MARK is a
// 1.24 us active-high pulse at the core every ~722 us. The PIO keeps sampling
// while the gate is off; the drive sends zeros then, which land in the gaps.
static volatile gating_mode_t s_gating_mode         = GATING_BOTH;
static volatile uint32_t      s_gating_drop_us      = 3;    // pulse at the mark
static volatile uint32_t      s_gating_data_us      = 37;   // mark -> second pulse start
static volatile uint32_t      s_gating_data_drop_us = 11;   // second pulse width
static volatile uint32_t      s_last_gate_drops     = 0;
static volatile int32_t       s_last_first_mark_us  = -1;

typedef struct {
    bool            sm_prev;
    bool            data_pending;
    bool            have_index;
    absolute_time_t t_index;
    absolute_time_t t_mark;
    uint32_t        drops;
    int32_t         first_mark_us;
} gate_ctx_t;

static inline void gate_pulse_off(uint32_t us) {
    gpio_put(PIN_READ_GATE_N, 1);          // deassert (active-low)
    busy_wait_us_32(us);
    gpio_put(PIN_READ_GATE_N, 0);          // re-assert; PLO resyncs in the gap
}

static void gate_ctx_init(gate_ctx_t *g) {
    g->sm_prev       = gpio_get(PIN_SECTOR_MARK);
    g->data_pending  = false;
    g->have_index    = false;
    g->drops         = 0;
    g->first_mark_us = -1;
}

static inline void gate_service(gate_ctx_t *g) {
    gating_mode_t mode = s_gating_mode;
    if (mode == GATING_OFF) return;
    bool sm = gpio_get(PIN_SECTOR_MARK);   // active-high at the core
    if (sm && !g->sm_prev) {               // leading edge of the mark
        g->t_mark = get_absolute_time();
        if (g->have_index && g->first_mark_us < 0)
            g->first_mark_us = (int32_t)absolute_time_diff_us(g->t_index, g->t_mark);
        gate_pulse_off(s_gating_drop_us);
        g->drops++;
        g->data_pending = (mode == GATING_BOTH);
    }
    g->sm_prev = sm;
    if (g->data_pending &&
        absolute_time_diff_us(g->t_mark, get_absolute_time()) >= (int64_t)s_gating_data_us) {
        gate_pulse_off(s_gating_data_drop_us);
        g->drops++;
        g->data_pending = false;
    }
}

void capture_set_gating(gating_mode_t mode, uint32_t drop_us,
                        uint32_t data_off_us, uint32_t data_drop_us) {
    if (drop_us < 1u)        drop_us = 1u;
    if (drop_us > 50u)       drop_us = 50u;
    if (data_off_us < 5u)    data_off_us = 5u;
    if (data_off_us > 600u)  data_off_us = 600u;
    if (data_drop_us < 1u)   data_drop_us = 1u;
    if (data_drop_us > 60u)  data_drop_us = 60u;
    s_gating_mode         = mode;
    s_gating_drop_us      = drop_us;
    s_gating_data_us      = data_off_us;
    s_gating_data_drop_us = data_drop_us;
}
gating_mode_t capture_gating_mode(void)          { return s_gating_mode; }
uint32_t      capture_gating_drop_us(void)       { return s_gating_drop_us; }
uint32_t      capture_gating_data_us(void)       { return s_gating_data_us; }
uint32_t      capture_gating_data_drop_us(void)  { return s_gating_data_drop_us; }
uint32_t      capture_last_gate_drops(void)      { return s_last_gate_drops; }
int32_t       capture_last_first_mark_us(void)   { return s_last_first_mark_us; }
const char   *capture_gating_name(gating_mode_t mode) {
    switch (mode) {
        case GATING_MARK: return "mark";
        case GATING_BOTH: return "both";
        default:          return "off";
    }
}

static void capture_init(void) {
    // pio1, not pio0: cyw43_arch_init() (LED heartbeat) claims its SPI SM from
    // pio0 at boot; a separate block keeps the two programs out of the same
    // 32-slot instruction memory (CORE-5 "separate blocks").
    s_pio = pio1;
    s_sm  = (uint)pio_claim_unused_sm(s_pio, true);
    s_offset = (uint)pio_add_program(s_pio, &capture_program);

    pio_sm_config c = capture_program_get_default_config(s_offset);
    sm_config_set_in_pins(&c, PIN_READ_DATA);                 // `in pins,1` source
    sm_config_set_in_shift(&c, /*shift_right=*/true,
                               /*autopush=*/true, /*push_threshold=*/32);
    sm_config_set_clkdiv(&c, 1.0f);                           // follow external clock

    // Route the two input pins to the PIO; both are inputs.
    pio_gpio_init(s_pio, PIN_READ_DATA);
    pio_gpio_init(s_pio, PIN_READ_REF_CLK);
    pio_sm_set_consecutive_pindirs(s_pio, s_sm, PIN_READ_DATA, 1, false);
    pio_sm_set_consecutive_pindirs(s_pio, s_sm, PIN_READ_REF_CLK, 1, false);

    pio_sm_init(s_pio, s_sm, s_offset, &c);   // leave disabled; armed per-track

    // DMA: PIO RX FIFO -> track buffer, paced by the RX DREQ.
    s_dma_chan = dma_claim_unused_channel(true);
    dma_channel_config dc = dma_channel_get_default_config(s_dma_chan);
    channel_config_set_transfer_data_size(&dc, DMA_SIZE_32);
    channel_config_set_read_increment(&dc, false);            // fixed FIFO address
    channel_config_set_write_increment(&dc, true);            // walk the buffer
    channel_config_set_dreq(&dc, pio_get_dreq(s_pio, s_sm, false /*rx*/));
    dma_channel_configure(s_dma_chan, &dc,
                          s_track_buf, &s_pio->rxf[s_sm], CAPTURE_WORDS, false);

    // INDEX and SECTOR MARK as plain inputs (active-high at the core via U3).
    gpio_init(PIN_INDEX);
    gpio_set_dir(PIN_INDEX, GPIO_IN);
    gpio_init(PIN_SECTOR_MARK);
    gpio_set_dir(PIN_SECTOR_MARK, GPIO_IN);
}

// Wait for a rising edge of INDEX (0->1), servicing the gate re-sync while we
// wait so the PLO has been re-acquired in a gap before sampling starts.
// Returns false on timeout.
static bool wait_index_rising(gate_ctx_t *g) {
    absolute_time_t deadline = make_timeout_time_us(INDEX_TIMEOUT_US);
    while (gpio_get(PIN_INDEX)) {                 // wait for a low (between pulses)
        gate_service(g);
        if (time_reached(deadline)) return false;
    }
    while (!gpio_get(PIN_INDEX)) {                // then the rising edge
        gate_service(g);
        if (time_reached(deadline)) return false;
    }
    return true;
}

// Perform one INDEX-aligned whole-track capture. Returns words captured (==
// CAPTURE_WORDS) or 0 on failure. Head select / -READ GATE / settling are the
// caller's responsibility (done on core0 before requesting GO).
static uint32_t capture_do(void) {
    // Reset SM + FIFOs and point the PC back at the program start.
    pio_sm_set_enabled(s_pio, s_sm, false);
    pio_sm_clear_fifos(s_pio, s_sm);
    pio_sm_restart(s_pio, s_sm);
    pio_sm_exec(s_pio, s_sm, pio_encode_jmp(s_offset));

    // Re-arm DMA at the buffer start.
    dma_channel_set_write_addr(s_dma_chan, s_track_buf, false);
    dma_channel_set_trans_count(s_dma_chan, CAPTURE_WORDS, false);

    // Align the capture window to the start of a revolution (CAP-3).
    gate_ctx_t g;
    gate_ctx_init(&g);
    s_last_gate_drops = 0;
    s_last_first_mark_us = -1;
    if (!wait_index_rising(&g)) { s_last_gate_drops = g.drops; return 0; }
    g.t_index = get_absolute_time();
    g.have_index = true;

    // Arm DMA, then enable the SM so sampling begins immediately after INDEX.
    dma_channel_start(s_dma_chan);
    pio_sm_set_enabled(s_pio, s_sm, true);

    // Block until one full track (+margin) has DMA'd in; bounded, so a
    // stalled clock returns a partial count instead of wedging core1.
    absolute_time_t deadline = make_timeout_time_ms(DMA_TIMEOUT_MS);
    while (dma_channel_is_busy(s_dma_chan)) {
        gate_service(&g);
        if (time_reached(deadline)) {
            dma_channel_abort(s_dma_chan);
            pio_sm_set_enabled(s_pio, s_sm, false);
            s_last_gate_drops = g.drops;
            s_last_first_mark_us = g.first_mark_us;
            // TRANS_COUNT holds transfers *remaining* after an abort.
            uint32_t remaining = dma_channel_hw_addr(s_dma_chan)->transfer_count;
            return CAPTURE_WORDS - remaining;
        }
    }
    pio_sm_set_enabled(s_pio, s_sm, false);
    s_last_gate_drops = g.drops;
    s_last_first_mark_us = g.first_mark_us;
    return CAPTURE_WORDS;
}

void capture_core_main(void) {
    capture_init();
    multicore_fifo_push_blocking(CAP_MSG_READY);
    for (;;) {
        uint32_t req = multicore_fifo_pop_blocking();
        if (req == CAP_REQ_GO) {
            uint32_t words = capture_do();
            multicore_fifo_push_blocking(words ? words : CAP_RESP_FAIL);
        } else {
            multicore_fifo_push_blocking(CAP_RESP_FAIL);
        }
    }
}

// Launch core1 on first use so the console/bus never block on PIO/DMA bring-up.
static bool s_core1_started = false;

bool capture_ensure_started(void) {
    if (s_core1_started) return false;
    multicore_launch_core1(capture_core_main);
    while (multicore_fifo_pop_blocking() != CAP_MSG_READY) { /* spin */ }
    s_core1_started = true;
    return true;
}

uint32_t capture_run_blocking(void) {
    capture_ensure_started();
    multicore_fifo_push_blocking(CAP_REQ_GO);
    uint32_t r = multicore_fifo_pop_blocking();
    return (r == CAP_RESP_FAIL) ? 0u : r;
}

const uint32_t *capture_buffer(void)              { return s_track_buf; }
uint32_t        capture_buffer_capacity_words(void) { return CAPTURE_WORDS; }
